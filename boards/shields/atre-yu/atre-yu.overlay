#include "atre-yu.dtsi"

&kscan0 {
  col-gpios
    = <&gpio0 31 GPIO_ACTIVE_HIGH>
    , <&gpio0 29 GPIO_ACTIVE_HIGH>
    , <&gpio0 24 GPIO_ACTIVE_HIGH>
    , <&gpio0 22 GPIO_ACTIVE_HIGH>
    , <&gpio0  8 GPIO_ACTIVE_HIGH>
    , <&gpio0  6 GPIO_ACTIVE_HIGH>
    ;

  row-gpios
    = <&gpio0 11 (GPIO_ACTIVE_HIGH | GPIO_PULL_DOWN)>
    , <&gpio1  0 (GPIO_ACTIVE_HIGH | GPIO_PULL_DOWN)>
    , <&gpio1  4 (GPIO_ACTIVE_HIGH | GPIO_PULL_DOWN)>
    , <&gpio1  6 (GPIO_ACTIVE_HIGH | GPIO_PULL_DOWN)>
    , <&gpio0  9 (GPIO_ACTIVE_HIGH | GPIO_PULL_DOWN)>
    , <&gpio1 15 (GPIO_ACTIVE_HIGH | GPIO_PULL_DOWN)>
    , <&gpio0  2 (GPIO_ACTIVE_HIGH | GPIO_PULL_DOWN)>
    , <&gpio1 13 (GPIO_ACTIVE_HIGH | GPIO_PULL_DOWN)>
    , <&gpio1 11 (GPIO_ACTIVE_HIGH | GPIO_PULL_DOWN)>
    , <&gpio0 10 (GPIO_ACTIVE_HIGH | GPIO_PULL_DOWN)>
    ;

  debounce-press-ms = <5>;
  debounce-release-ms = <5>;
};

&left_encoder {
    status = "okay";
};

&right_encoder {
    status = "okay";
};

&sensors {
    status = "okay";
};
